## conf/layer.conf
```bitbake
# We have a conf and classes directory, add to BBPATH
BBPATH .= ":${LAYERDIR}"

# We have recipes-* directories, add to BBFILES
BBFILES += "${LAYERDIR}/recipes-*/*/*.bb \
	${LAYERDIR}/recipes-*/*/*.bbappend"

BBFILE_COLLECTIONS += "stm-tsn-acm"
BBFILE_PATTERN_stm-tsn-acm = "^${LAYERDIR}/"
BBFILE_PRIORITY_stm-tsn-acm = "6"
LICENSE_PATH += "${LAYERDIR}/TTTECH-license"
SPDXLICENSEMAP[Commercial] = "TTTECH_license.txt"
# Set a variable to get the meta-st-stm32mp-tsn-acm location
TSN_ACM_LAYER = "${LAYERDIR}"

LAYERDEPENDS_stm-tsn-acm = "stm-tsn-base"

# OpenSTLinux compatibility version
ST_OSTL_COMPATIBILTY_VERSION_stm-tsn-acm = "6.0"

# This should only be incremented on significant changes that will
# cause compatibility issues with other layers
LAYERVERSION_stm-tsn-acm = "1"
LAYERSERIES_COMPAT_stm-tsn-acm = "scarthgap"

# Usage of external source
TSN_ACM_SRC_URI = "git://gitolite@codex.cro.st.com/mpu/oe/tsn/tttech-tsn-acm-content;protocol=ssh;branch=1.6.8"
TSN_ACM_SRCREV = "23e1ed7d9942136d0526d6f429f0efc3ed2fe35e"
```
